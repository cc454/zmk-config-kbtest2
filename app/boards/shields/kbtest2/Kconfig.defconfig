## app/boards/shields/kbtest2/Kconfig.defconfig
```kconfig
if SHIELD_KBTEST2_LEFT

config ZMK_KEYBOARD_NAME
    default "KBTest2"

config ZMK_SPLIT_ROLE_CENTRAL
    default y

endif

if SHIELD_KBTEST2_LEFT || SHIELD_KBTEST2_RIGHT

config ZMK_SPLIT
    default y

endif
```

## app/boards/shields/kbtest2/Kconfig.shield
```kconfig
config SHIELD_KBTEST2_LEFT
    def_bool $(shields_list_contains,kbtest2_left)

config SHIELD_KBTEST2_RIGHT
    def_bool $(shields_list_contains,kbtest2_right)
```

## app/boards/shields/kbtest2_left_test/Kconfig.defconfig
```kconfig
if SHIELD_KBTEST2_LEFT_TEST

config ZMK_KEYBOARD_NAME
    default "KBTest2 Left Test"

config ZMK_SPLIT
    default y

config ZMK_SPLIT_ROLE_CENTRAL
    default y

endif
```

## app/boards/shields/kbtest2_left_test/Kconfig.shield
```kconfig
config SHIELD_KBTEST2_LEFT_TEST
    def_bool $(shields_list_contains,kbtest2_left_test)
```
